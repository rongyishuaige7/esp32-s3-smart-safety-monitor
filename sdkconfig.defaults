## sdkconfig.defaults
```kconfig
# Stack / heap
CONFIG_ESP_MAIN_TASK_STACK_SIZE=8192
CONFIG_FREERTOS_HZ=1000

# Logging
CONFIG_LOG_DEFAULT_LEVEL_INFO=y

# I2C (OLED)
CONFIG_I2C_ENABLE_DEBUG_LOG=n

# ADC calibration (optional, helps MQ sensors)
CONFIG_ADC_ONESHOT_FORCE_USE_ADC2_ON_C3_S3=n

# Flash size (match your module; N8 = 8MB)
CONFIG_ESPTOOLPY_FLASHSIZE_8MB=y
```
